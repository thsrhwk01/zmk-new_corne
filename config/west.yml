## config/west.yml
```yaml
manifest:
  remotes:
    - name: zmkfirmware
      url-base: https://github.com/zmkfirmware
    # nice-view-gem
    # - name: m165437
    #   url-base: https://github.com/M165437
    - name: mctechnology17
      url-base: https://github.com/mctechnology17
  projects:
    - name: eyelash_corne
      url: https://github.com/thsrhwk01/zmk-new_corne
      revision: main
    - name: zmk
      remote: zmkfirmware
      revision: main
      import: app/west.yml
    # - name: nice-view-gem
    #   remote: m165437
    #   revision: main
    - name: zmk-nice-oled
      remote: mctechnology17
      revision: main
  self:
    path: config
```
